 /************************************************************************//**
 *	@brief	audiocodec.c holds function defination for the audiocodec function of the soc
 * 	@version 	V0.0
 * 	@date	  11.04.2016
 *	@author 	cosinuss
 ****************************************************************************/
/* Includes ----------------------------------------------------------------*/

#include "general_defination.h"
#include "audiocodec_public.h"
#include "audiocodec_config.h"
#include "nrf_twi.h"
#include "i2c1_master_public.h"
#include "i2s_master_public.h"
#include "nrf52_bitfields.h"
#include "nrf.h"
#include "nrf_drv_i2s.h"
#include "nrf_delay.h"
#include <stdint.h>
#include <cstdio>
#include <stdlib.h>
#include <string.h>

/* Private define ----------------------------------------------------------*/
#define SAMPLE_SIZE	3
#define	CONTINOUS_PLAY_MODE	//for debug purposes and for continous play of the audio track

/* Private function prototypes ---------------------------------------------*/

/* Private typedef ---------------------------------------------------------*/

/* Private variables -------------------------------------------------------*/
//below address are the address of codec registers that are configured through the master I2C1
const uint8_t config_address [] =  
	{DUMMY_CLOCK_CONFIG1_ADD, DUMMY_CLOCK_CONFIG2_ADD, DUMMY_CLOCK_CONFIG3_ADD, CP_VOL_THRESHOLD1_ADD,
	CP_DELAY,  CP_CTRL_ADD,  LDO_CTRL_ADD, SR_ADD, REFERENCES_ADD, PLL_FRAC_TOP_ADD,
	PLL_FRAC_BOTTOM_ADD, PLL_INTEGER_ADD, PLL_CTRL_ADD, DAI_CTRL_ADD, DIG_ROUTING_DAC_ADD, MIXOUT_L_SELECT_ADD, 
	MIXOUT_R_SELECT_ADD,  GAIN_RAMP_CTRL_ADD, SYSTEM_MODES_O_ADD, HP_L_GAIN_ADD, HP_R_GAIN_ADD};

static config_structure_t config_struct;	//declear an instance of the config struct for the codec

static i2s_data_structure_t	i2s_data_struct;
//data of various I2C1 write to the codec
const uint8_t codec_repeat_write[2] = {CIF_CTRL_ADD, CODEC_I2SWRITE_REPEAT_MODE};	//codec data for repeat mode write and also to reset the codec	
const uint8_t codec_reset[2] = {CIF_CTRL_ADD, CODEC_RESET_COMMAND};	//codec data to reset codec
const uint8_t codec_start[2] = {SYSTEM_ACTIVE_ADD, CODEC_I2START_COMMAND};	//codec data to start codec
const uint8_t codec_stop[2] = {SYSTEM_ACTIVE_ADD, CODEC_I2STOP_COMMAND};	//codec data to stop codec
const uint8_t pll_srm_enable[2] = {PLL_CTRL_ADD, PLL_CTRL_ENABLE_COMMAND};	//codec data toenable the PLL
uint8_t volume_control_data [4];	//register that holds the data for volume control
uint8_t *volume_cont_reg;			//pointer to device volume
uint8_t	device_volume;				//device control volume

//data for the word 9
//data has been truncated
const uint16_t sample_data_9[ ]= {
	1236,1012,690,414,212,65507,65296,65233,64973,64898,64760,64720,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64967
} ;

//data for the word 10
//data has been truncated
const uint16_t sample_data_10[ ]= {
	1236,1012,690,414,212,65507,65296,65233,64973,64898,64760,64720,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64967
//	65065,65441,65497,65283,65059,65228,64472,65259,65078,64723,64638,65379,65195,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752
};

//data for the word 19
//data has been truncated
const uint16_t sample_data_19[ ]= {
	1236,1012,690,414,212,65507,65296,65233,64973,64898,64760,64720,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64967

//	65457,947,748,4,317,152,308,204,295,213,232,189,223,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1099
};

//data for a silence period between two words
//data has been truncated
const uint16_t sample_data_4[ ]= {
4,23,65461,65446,65445,65435,65444,65436,65454,65467,65503,65527,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65490,
//4,23,65461,65446,65445,65435,65444,65436,65454,65467,65503,65527,65513,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65490,
};

const uint16_t  *data_address_pointer[10];	//pointer to start address of each of the data
	uint16_t messages_size[] = {sizeof(sample_data_4)/sizeof(sample_data_4[0]), sizeof(sample_data_9)/sizeof(sample_data_9[0]), sizeof(sample_data_4)/sizeof(sample_data_4[0]),sizeof(sample_data_10)/sizeof(sample_data_10[0]),
	sizeof(sample_data_4)/sizeof(sample_data_4[0]), sizeof(sample_data_19)/sizeof(sample_data_19[0]),sizeof(sample_data_4)/sizeof(sample_data_4[0])
	};

static uint8_t sample_size;	//holds size of sample to be sent out of the soc

//device configuration using sc1 type
//device is designed to write only
//device is configured in consecutive write mode
//all i2s codec settings are always backed up before transfer
//at startup all previous settings are read out ?? you need to verify device startup condition

/* Public functions --------------------------------------------------------*/																	
void audiocodec_config(void)
{
	sample_size = SAMPLE_SIZE;
	i2s_data_struct.buffer_moved_cou = 0;
	i2s_data_struct.data_sample_cou = 0;
	i2s_data_struct.total_data_moved_data_cou =0;
	i2s_data_struct.data_samples_max = 0;	//might not be needed
	i2s_data_struct.total_data_sample_size = 0;  
	i2s_data_struct.data_sample_index_cou = 0;
	device_volume = (BIT0+BIT3);		//+BIT4+BIT5
	
	//consider combining both together
	I2C1master_StartTX (Audiocodec_reset , false);	//reset device	

	I2C1master_StartTX (Audiocodec_repeat_write, false);	//enable repeat write mode

	//configure structure that holds the configuration for the audiocodec
	config_struct.sr =	(BIT0);	 		//sample rate of 8KHz 
	config_struct.references =	(BIT3);	//master bias enable
	config_struct.pll_frac_top = (PLL_FRAC_TOP_VALUE);	//  pll fractional top value
	config_struct.pll_frac_buttom = (PLL_FRAC_BOTTON_VALUE);		//pll fractional botton value
	config_struct.pll_integer = (PLL_INTEGER);									//pll integer value
	config_struct.pll_ctrl = (BIT6+BIT7);	//(BIT6+BIT7);	//enable pll in slave mode (SRM)
	config_struct.dig_routing_dai = (BIT1+BIT5);	//left dai channel only and dac l & r output	
	config_struct.cp_ctrl = (BIT0+BIT2+BIT3+BIT6+BIT7);	//charge pump enable and configuration
	config_struct.hp_l_gain = device_volume;	//set hp volume to 0db  , +BIT3
	config_struct.hp_r_gain = device_volume;	//set hp volume to 0db
	config_struct.mixout_l_select = (BIT3);	//mixer input is only from the DAC_L
	config_struct.mixout_r_select = (BIT3);	//mixer input is only from the DAC_R
	config_struct.dummy_clock_config1 = (0x8b);	//config to dummy addresses
	config_struct.dummy_clock_config2 = (0x03);
	config_struct.dummy_clock_config3 = (0x00);
	config_struct.ldo_ctrl = (BIT7);	//enable ldo
	//config_struct.gain_ramp_ctrl = (BIT1);		//norminal rate *16 for the ramp rate
	config_struct.cp_vol_threshold1 = (BIT1+BIT2+BIT4+BIT5);
	config_struct.cp_delay	= (BIT0+BIT2+BIT5+BIT7);	//enable automatic operataion
	config_struct.dai_ctrl	= (BIT7+BIT6);	//enable dai and 16 bit left justified
	config_struct.system_mode = (BIT0+BIT3+BIT4+BIT5+BIT6+BIT7);	//activate DAC, hp, line and mixer amplifiers

//initialize the audio codec via i2c1
	I2C1master_StartTX (Audiocodec_init, false);
	
	nrf_delay_ms(500);		//delay for 500ms to enable audio codec startup
}
     
//transfer data into the i2c buffer 
//and also returns the data size
uint8_t audiocodec_transmit_data_i2c1(Transmit_owner owner_id, uint8_t *transmit_buffer_i2c)
{
	uint16_t datasize;
	switch (owner_id)
	{
		case(No_owner):	//no owner, do nothing
			{	

			}
		break;
		case(Audiocodec_reset):	//for audio codec reset
			{
				datasize = (sizeof(codec_reset)/ sizeof(uint8_t));
				for (uint8_t counter = 0; counter <datasize; counter++)
				{
					transmit_buffer_i2c[counter] = codec_reset[counter];
				}
			}
		break;
		case(Pll_srm_detect):	//to write codec pll to enable pll_smc
			{
				datasize = (sizeof(pll_srm_enable)/ sizeof(uint8_t));
				for (uint8_t counter = 0; counter <datasize; counter++)
				{
					transmit_buffer_i2c[counter] = pll_srm_enable[counter];
				}
			}
		break;
		case(Audiocodec_repeat_write):	//for audio codec enable repeat write mode
			{
				datasize = (sizeof(codec_repeat_write)/ sizeof(uint8_t));
				for (uint8_t counter = 0; counter <datasize; counter++)
				{
					transmit_buffer_i2c[counter] = codec_repeat_write[counter];
				}
			}
		break;	
		case(Audiocodec_init):	//for audio codec initialisation
			{
				config_structure_t * config_struct_pointer;
				config_struct_pointer = &config_struct;
				uint8_t next_pointer_value = 0;
				datasize = (sizeof(config_address)/ sizeof(uint8_t))* 2;
				for (uint8_t counter = 0; counter <datasize; counter++)
				{
					transmit_buffer_i2c[counter] = config_address[next_pointer_value];
					counter++;
					transmit_buffer_i2c[counter] = *((uint8_t*)config_struct_pointer + next_pointer_value);		//move data into buffer
					next_pointer_value++;
				}
			}
		break;
		case (Audiocodec_enable):		//to enbale audio codec 
		break;			
		case (Audiocodec_i2s_start):
			{
				datasize = (sizeof(codec_start)/ sizeof(uint8_t));
				for (uint8_t counter = 0; counter <datasize; counter++)
				{
					transmit_buffer_i2c[counter] = codec_start[counter];
				}
			}		
		break;	
		case (Audiocodec_vol): 	//to increase or decrease volume
			{
				datasize = (sizeof(volume_control_data)/ sizeof(uint8_t));
				for (uint8_t counter = 0; counter <datasize; counter++)
				{
					transmit_buffer_i2c[counter] = volume_control_data[counter];
				}
			}
		break;	
		case (Audiocodec_stand_by):
			{	
				datasize = (sizeof(codec_stop)/ sizeof(uint8_t));			
				for (uint8_t counter = 0; counter <datasize; counter++)
				{
					transmit_buffer_i2c[counter] = codec_stop[counter];		//divide by 2 move address into buffer
				}
			}				
		break;		
		default:
		break;
	}
	return datasize;
};

//handler to fetch i2s next buffer size data
void audiocodec_transmitdata_update_i2s(uint32_t * p_buffer, uint16_t number_of_words)
{
	//update record of data moved from host to slave
	i2s_data_struct.total_data_moved_data_cou = (i2s_data_struct.total_data_moved_data_cou + (i2s_data_struct.buffer_size * 2));
	i2s_data_struct.buffer_moved_cou++;	//this is not effective because the nrf driver determines what is moved

	//test for if all data has been moved out
	//or you could use above
	//if (i2s_data_struct.buffer_moved_cou =<i2s_data_struct.data_samples_max)
	if ((i2s_data_struct.total_data_sample_size - i2s_data_struct.total_data_moved_data_cou) < 04 )	
	{	
		#ifdef CONTINOUS_PLAY_MODE
		i2s_data_struct.buffer_moved_cou = 0;	//not ussefull
		i2s_data_struct.data_sample_cou = 0;
		i2s_data_struct.total_data_moved_data_cou =0;
		i2s_data_struct.data_samples_max = 0;	//might not be needed
		i2s_data_struct.total_data_sample_size = 0;  
		i2s_data_struct.data_sample_index_cou = 0;	
		audiocodec_i2s_data_prep();		
		#else
		//ending the code here is not efficient
		audiocodec_i2s_end();
		return;
		#endif
	}
	
	//check for remaining data to be moved if it is too small
	//prevention of hardfault 
	if ((i2s_data_struct.total_data_sample_size - i2s_data_struct.total_data_moved_data_cou) < (number_of_words *2))
	{
			number_of_words =((i2s_data_struct.total_data_sample_size - i2s_data_struct.total_data_moved_data_cou) >>1);
	}
	uint16_t  main_counter;		//keeps track of the data been transfered to the buffer of the start driver function

	for (main_counter = 0; main_counter < number_of_words; main_counter++)	//move data to buffer
	{
		//include codes incase you run out of data
		((uint16_t *)p_buffer)[(2 * main_counter)] = *(data_address_pointer[i2s_data_struct.data_sample_cou] + (i2s_data_struct.data_sample_index_cou));	///move data to lower 16 bit
		i2s_data_struct.data_sample_index_cou ++;
		((uint16_t *)p_buffer)[(2* main_counter) + 1] = *(data_address_pointer[i2s_data_struct.data_sample_cou] + (i2s_data_struct.data_sample_index_cou));	//move data to upper 16 bits
		i2s_data_struct.data_sample_index_cou ++;
		if ((i2s_data_struct.data_size[i2s_data_struct.data_sample_cou] - 1) < (i2s_data_struct.data_sample_index_cou))	// if all data of a sample has been moved out
		{
			i2s_data_struct.data_sample_cou++;	//next data sample
			i2s_data_struct.data_sample_index_cou = 0;	//start from index 0 of next data sample
		}
		//include code in case you run out of data here ????
	}
	i2s_data_struct.buffer_size	=	number_of_words;		//capture buffer size and amount of data that is been sent out now
};

//prepare data to be sent out by the I2S master
//enable audio chip using i2c1
void audiocodec_i2s_data_prep()
{
	//modify this code to be dynamic
	//else store data samples in an array for easy access
	//data_address_pointer[0] =  sample_data;	//{sample_data};
	//allocating the messages to an array
	
	data_address_pointer[0] = &sample_data_4[0];
	data_address_pointer[1] = &sample_data_9[0];
	data_address_pointer[2] = &sample_data_4[0];
	data_address_pointer[3] = &sample_data_10[0];
	data_address_pointer[4] = &sample_data_4[0];
	data_address_pointer[5] = &sample_data_19[0];
	data_address_pointer[6] = &sample_data_4[0];
	
	//uint8_t pointer_size = sizeof(*data_address_pointer);
	uint16_t size = sizeof(messages_size)/sizeof(uint16_t);
	
	//calculate the size of each data sample to be outputed
	//calculate the total data size
	//calculate the total number of samples
	for (int cou = 0; cou <size; cou++)
	{
		i2s_data_struct.data_size[cou] =  messages_size[cou];	//amount of data in each sample
		i2s_data_struct.data_samples_max++;	//count number of samples
		i2s_data_struct.total_data_sample_size =  i2s_data_struct.total_data_sample_size + i2s_data_struct.data_size[cou ] ;	//add up total data
	}
	//allocate first buffer size  
	i2s_data_struct.buffer_size = (I2S_DATA_SIZE);	//size of buffer it will hold x2 the amount of data
}

void audiocodec_stop_i2s( )
{
	I2C1master_StartTX (Audiocodec_stand_by, false);	//put codec i2s into standby mode
	nrf_drv_i2s_stop();
}

void audiocodec_i2s_end()
{
	nrf_drv_i2s_stop();
	I2C1master_StartTX (Audiocodec_stand_by, false);	//put codec i2s into standby mode
}

//move first data set into buffer, set size of buffer
void audiocodec_i2s_start_transmit_data(uint32_t *i2s_data_transmit, uint16_t *i2s_data_size)
{
	*i2s_data_size = (i2s_data_struct.buffer_size); 
	uint16_t  main_counter;		//keeps track of the data been transfered to the buffer of the start driver function
	for (main_counter = 0; main_counter < ((i2s_data_struct.buffer_size)); main_counter++)	//move data to buffer for start function, half of the buffer willbe filled
	{
		((uint16_t *)i2s_data_transmit)[(2*main_counter)] = (*(data_address_pointer[i2s_data_struct.data_sample_cou] + i2s_data_struct.data_sample_index_cou));	//move to first 16bit
		i2s_data_struct.data_sample_index_cou ++;
		((uint16_t *)i2s_data_transmit)[(2*main_counter)+1] =  (*(data_address_pointer[i2s_data_struct.data_sample_cou] + i2s_data_struct.data_sample_index_cou));		//move to 2nd 16bit
		i2s_data_struct.data_sample_index_cou ++;
		//if all first sample size has been moved to buffer, move to the next sample size
		//?? am not sure what the -1 is doing there
		if ((i2s_data_struct.data_size[i2s_data_struct.data_sample_cou] - 1) < (i2s_data_struct.data_sample_index_cou))	//  if all data of a sample has been moved out inot the buffer
		{
			i2s_data_struct.data_sample_cou++;	//next data sample
			i2s_data_struct.data_sample_index_cou = 0;	//start from index 0 of next data sample
		}	
	}
}

void audiocodec_volume_control(uint8_t control_option)
{
	switch (control_option)
	{
		volume_cont_reg = &volume_control_data[0];
		case(1):
		if (device_volume < (MAX_AMP_GAIN +1))
			{
				device_volume++;
				volume_control_data[0] = 	HP_R_GAIN_ADD;
				volume_control_data[1] = 	device_volume;
				volume_control_data[2] = 	HP_L_GAIN_ADD	;
				volume_control_data[3] = 	device_volume; 	
				I2C1master_StartTX (Audiocodec_vol , false);	//volume increase
			}
		break;	
		case(0):
			if (device_volume > MIN_AMP_GAIN)
			{
				device_volume--;
				volume_control_data[0] = 	HP_R_GAIN_ADD;
				volume_control_data[1] = 	device_volume;
				volume_control_data[2] = 	HP_L_GAIN_ADD	;
				volume_control_data[3] = 	device_volume;		
				I2C1master_StartTX (Audiocodec_vol, false);	//volume decrease				
			}
		break;
	}
}